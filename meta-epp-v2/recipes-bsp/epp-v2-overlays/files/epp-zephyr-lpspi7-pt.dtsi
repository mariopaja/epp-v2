// SPDX-License-Identifier: GPL-2.0
/*
 * Xen passthrough fragment "lpspi7": LPSPI7 on the 40-pin header J19, pin 26
 * SCK (GPIO_IO07), pin 31 SOUT/MOSI (GPIO_IO06), pin 29 SIN/MISO
 * (GPIO_IO05). Its PCS0 pad is the green LED, so the chip select is a GPIO2
 * pin (pin 35, GPIO_IO19), driven by Zephyr; device reset (pin 37) and
 * interrupt (pin 36) are GPIO2 pins as well. Disabled and unused in Linux.
 * Registers mapped 1:1, no interrupts and no DMA (the Zephyr driver polls).
 * Part of the /passthrough node of epp-zephyr-pt-<combination>.dts.
 */

spi@42710000 {
	compatible = "fsl,imx95-spi", "fsl,imx7ulp-spi";
	reg = <0x0 0x42710000 0x0 0x10000>;
	xen,path = "/soc/bus@42000000/spi@42710000";
	xen,reg = <0x0 0x42710000 0x0 0x10000 0x0 0x42710000>;
	xen,force-assign-without-iommu;
};
