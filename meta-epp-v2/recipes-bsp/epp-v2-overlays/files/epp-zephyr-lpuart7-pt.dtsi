// SPDX-License-Identifier: GPL-2.0
/*
 * Xen passthrough fragment "lpuart7": LPUART7 on the 40-pin header J19, pin
 * 24 TX (GPIO_IO08) and pin 21 RX (GPIO_IO09). Disabled and unused in Linux.
 * Registers mapped 1:1, no interrupts and no DMA (the Zephyr driver polls).
 * Part of the /passthrough node of epp-zephyr-pt-<combination>.dts.
 */

serial@42690000 {
	compatible = "fsl,imx95-lpuart", "fsl,imx8ulp-lpuart", "fsl,imx7ulp-lpuart";
	reg = <0x0 0x42690000 0x0 0x1000>;
	xen,path = "/soc/bus@42000000/serial@42690000";
	xen,reg = <0x0 0x42690000 0x0 0x1000 0x0 0x42690000>;
	xen,force-assign-without-iommu;
};
