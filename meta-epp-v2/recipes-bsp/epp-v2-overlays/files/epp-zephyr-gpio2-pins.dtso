// SPDX-License-Identifier: GPL-2.0
/*
 * GPIO2 passed through to the Zephyr DomU (EPP_XEN_ZEPHYR_PASSTHROUGH =
 * "gpio2"): Xen disables it for Dom0, so Linux no longer sets the pins of
 * its users. Set the RGB LED D19 pads to GPIO once at boot with the SCMI
 * pinctrl hog: GPIO_IO04 (green), GPIO_IO12 (blue), GPIO_IO13 (red).
 * Added to EPP_OVERLAYS by scripts/yocto-build.sh.
 */

#include "imx95-pinfunc.h"

/dts-v1/;
/plugin/;

&scmi_iomuxc {
	pinctrl-0 = <&pinctrl_hog &pinctrl_epp_led>;

	pinctrl_epp_led: eppledgrp {
		fsl,pins = <
			IMX95_PAD_GPIO_IO04__GPIO2_IO_BIT4	0x31e
			IMX95_PAD_GPIO_IO12__GPIO2_IO_BIT12	0x31e
			IMX95_PAD_GPIO_IO13__GPIO2_IO_BIT13	0x31e
		>;
	};
};
