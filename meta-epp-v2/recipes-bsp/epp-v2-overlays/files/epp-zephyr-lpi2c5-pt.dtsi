// SPDX-License-Identifier: GPL-2.0
/*
 * Xen passthrough fragment "lpi2c5": LPI2C5 on the 40-pin header J19, pin
 * 27 (SDA, GPIO_IO00) and pin 28 (SCL, GPIO_IO01). Disabled and unused in
 * Linux. Registers mapped 1:1, no interrupts and no DMA (the Zephyr driver
 * polls). Part of the /passthrough node of epp-zephyr-pt-<option>.dts.
 */

i2c@426b0000 {
	compatible = "fsl,imx95-lpi2c", "fsl,imx7ulp-lpi2c";
	reg = <0x0 0x426b0000 0x0 0x10000>;
	xen,path = "/soc/bus@42000000/i2c@426b0000";
	xen,reg = <0x0 0x426b0000 0x0 0x10000 0x0 0x426b0000>;
	xen,force-assign-without-iommu;
};
