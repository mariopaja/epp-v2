// SPDX-License-Identifier: GPL-2.0
/*
 * Xen passthrough fragment "lpi2c7": LPI2C7 on the 40-pin header J19, pin
 * 31 (SDA, GPIO_IO06) and pin 26 (SCL, GPIO_IO07). Disabled and unused in
 * Linux. Registers mapped 1:1, no interrupts and no DMA (the Zephyr driver
 * polls). Part of the /passthrough node of epp-zephyr-pt-<option>.dts.
 */

i2c@426d0000 {
	compatible = "fsl,imx95-lpi2c", "fsl,imx7ulp-lpi2c";
	reg = <0x0 0x426d0000 0x0 0x10000>;
	xen,path = "/soc/bus@42000000/i2c@426d0000";
	xen,reg = <0x0 0x426d0000 0x0 0x10000 0x0 0x426d0000>;
	xen,force-assign-without-iommu;
};
