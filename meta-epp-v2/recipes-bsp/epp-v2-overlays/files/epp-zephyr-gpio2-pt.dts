// SPDX-License-Identifier: GPL-2.0
/*
 * Xen dom0less partial device tree: pass GPIO2 (RGB LED D19: green
 * GPIO_IO04, blue GPIO_IO12, red GPIO_IO13; and the GPIO_IOxx pins on the
 * 40-pin header) through to the Zephyr DomU. Loaded by boot.scr as module of
 * /chosen/domU2 (zephyr-domu-pt.dtb) with EPP_XEN_ZEPHYR_PASSTHROUGH =
 * "gpio2". Registers mapped 1:1; no interrupts (the Zephyr driver polls).
 * No DMA, so no IOMMU needed (the SMMU is off for Xen).
 */

/dts-v1/;

/ {
	#address-cells = <2>;
	#size-cells = <2>;

	gic: gic {
		#interrupt-cells = <3>;
		interrupt-controller;
	};

	passthrough {
		compatible = "simple-bus";
		ranges;
		#address-cells = <2>;
		#size-cells = <2>;

		gpio@43810000 {
			compatible = "fsl,imx95-gpio", "fsl,imx8ulp-gpio";
			reg = <0x0 0x43810000 0x0 0x1000>;
			xen,path = "/soc/gpio@43810000";
			xen,reg = <0x0 0x43810000 0x0 0x1000 0x0 0x43810000>;
			xen,force-assign-without-iommu;
		};
	};
};
