// SPDX-License-Identifier: GPL-2.0
/*
 * Pin mux fragment "lpi2c4": GPIO_IO30 (SDA) and GPIO_IO31 (SCL) as LPI2C4,
 * as in pinctrl_lpi2c4 of imx95-15x15-frdm.dts. Part of
 * epp-zephyr-pt-pins.dtso (SCMI pinctrl hog, set once when Dom0 boots).
 */

pinctrl_epp_lpi2c4: epplpi2c4grp {
	fsl,pins = <
		IMX95_PAD_GPIO_IO30__LPI2C4_SDA		0x40000b9e
		IMX95_PAD_GPIO_IO31__LPI2C4_SCL		0x40000b9e
	>;
};
