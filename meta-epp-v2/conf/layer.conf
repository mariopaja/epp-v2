## zephyr/Kconfig
```kconfig
# SPDX-License-Identifier: Apache-2.0

menu "epp-v2"

config EPP_XEN_XENSTORE
	bool "Xenstore client for a Xen DomU"
	depends on XEN && !XEN_DOM0
	help
	  Xenstore client for a Zephyr DomU (read, write, directory) over the
	  xenstore ring page and event channel Xen provides to the domain. For
	  dom0less domains the domain needs "xen,enhanced"; the client waits
	  until Dom0 (init-dom0less) has set up the xenstore page.

config EPP_XEN_NETFRONT
	bool "Xen PV network frontend (netfront) for a Xen DomU"
	depends on NETWORKING && EPP_XEN_XENSTORE
	select NET_L2_ETHERNET
	help
	  Ethernet interface on the Xen vif Dom0 attaches to the domain
	  (xl network-attach), e.g. bridged to the physical network in Dom0.
	  One queue, one page per packet, rx-copy.

if EPP_XEN_NETFRONT

config EPP_XEN_NETFRONT_RX_BUFS
	int "Receive buffers (pages)"
	default 32

config EPP_XEN_NETFRONT_TX_BUFS
	int "Transmit buffers (pages)"
	default 16

config EPP_XEN_NETFRONT_XENSTORE_TIMEOUT
	int "Seconds to wait for xenstore"
	default 300

config EPP_XEN_NETFRONT_THREAD_STACK_SIZE
	int "Netfront thread stack size"
	default 2048

config EPP_XEN_NETFRONT_THREAD_PRIORITY
	int "Netfront thread priority"
	default 2

module = EPP_XEN_NETFRONT
module-str = Xen netfront
source "subsys/logging/Kconfig.template.log_config"

endif # EPP_XEN_NETFRONT

config EPP_XEN_RGPIO
	bool "NXP RGPIO passed through to a Xen DomU"
	default y
	depends on GPIO && DT_HAS_EPP_XEN_RGPIO_ENABLED
	help
	  Minimal driver for an RGPIO controller Xen passes through to the DomU
	  (compatible "epp,xen-rgpio"): no SCMI and no pinctrl, the System
	  Manager and Dom0 set those up. No interrupts.

endmenu
```

## zephyr/boards/nxp/frdm_imx95/board.yml
```yaml
board:
  name: frdm_imx95
  full_name: FRDM i.MX95 (15x15, LPDDR4x)
  vendor: nxp
  socs:
  - name: mimx9596
```

## zephyr/boards/nxp/frdm_imx95/frdm_imx95_mimx9596_m7_defconfig
```kconfig
#
# Copyright 2026 NXP
# SPDX-License-Identifier: Apache-2.0
#

# Same as imx95_evk_15x15 M7
CONFIG_CLOCK_CONTROL=y
CONFIG_SERIAL=y
CONFIG_UART_CONSOLE=y
CONFIG_UART_INTERRUPT_DRIVEN=y
CONFIG_CONSOLE=y
CONFIG_XIP=y
CONFIG_MBOX=y
CONFIG_MBOX_INIT_PRIORITY=0
CONFIG_ARM_SCMI=y
CONFIG_ARM_SCMI_NXP_VENDOR_EXTENSIONS=y
```

## zephyr/dts/bindings/can/epp,xen-flexcan.yaml
```yaml
# SPDX-License-Identifier: Apache-2.0

description: |
  NXP FlexCAN controller passed through by Xen to a Zephyr DomU. Pin mux and
  clock are set up outside the DomU (System Manager, Dom0), so there are no
  pinctrl or clocks properties. Classic CAN, mailboxes, interrupt driven
  (the controller's interrupt routed by Xen).

compatible: "epp,xen-flexcan"

include: [can-controller.yaml, base.yaml]

properties:
  reg:
    required: true

  interrupts:
    required: true

  functional-clock-frequency:
    type: int
    default: 24000000
    description: |
      FlexCAN protocol engine clock in Hz (CAN clock root of the controller,
      CTRL1[CLKSRC] = 0), as set by the System Manager (Linux in Dom0:
      /sys/kernel/debug/clk/canN/clk_rate). Default of an unused CAN root:
      24 MHz; Linux sets 40 MHz while it owns the controller.
```

## zephyr/dts/bindings/gpio/epp,xen-rgpio.yaml
```yaml
# SPDX-License-Identifier: Apache-2.0

description: |
  NXP RGPIO controller passed through by Xen to a Zephyr DomU (xenvm). Pin
  mux and clocks are set up outside the DomU (System Manager, Dom0), so the
  driver needs neither SCMI nor pinctrl. Pin interrupts (edges, levels)
  when the node has "interrupts" (the GPIO interrupt routed by Xen, e.g.
  GIC SPI 49 for GPIO2).

compatible: "epp,xen-rgpio"

include: [gpio-controller.yaml, base.yaml]

properties:
  reg:
    required: true

  "#gpio-cells":
    const: 2

gpio-cells:
  - pin
  - flags
```

## zephyr/dts/bindings/i2c/epp,xen-lpi2c.yaml
```yaml
# SPDX-License-Identifier: Apache-2.0

description: |
  NXP LPI2C controller passed through by Xen to a Zephyr DomU. Pin mux and
  clock are set up outside the DomU (System Manager, Dom0), so there are no
  pinctrl or clocks properties. Controller mode, polled, no interrupts.

compatible: "epp,xen-lpi2c"

include: [i2c-controller.yaml, base.yaml]

properties:
  reg:
    required: true

  functional-clock-frequency:
    type: int
    default: 24000000
    description: |
      LPI2C functional clock in Hz, as set by the System Manager (Linux in
      Dom0: /sys/kernel/debug/clk/lpi2cN/clk_rate). The SCL timing is
      derived from it.
```

## zephyr/dts/bindings/serial/epp,xen-lpuart.yaml
```yaml
# SPDX-License-Identifier: Apache-2.0

description: |
  NXP LPUART passed through by Xen to a Zephyr DomU. Pin mux and clock are
  set up outside the DomU (System Manager, Dom0), so there are no pinctrl or
  clocks properties. Polled, 8N1.

compatible: "epp,xen-lpuart"

include: [uart-controller.yaml, base.yaml]

properties:
  reg:
    required: true

  current-speed:
    default: 115200

  internal-loopback:
    type: boolean
    description: |
      Test aid: connect TX to RX inside the LPUART (CTRL[LOOPS]), without
      the pins, to test the driver and the passthrough separately from the
      pin path.

  functional-clock-frequency:
    type: int
    default: 24000000
    description: |
      LPUART functional clock in Hz, as set by the System Manager (Linux in
      Dom0: /sys/kernel/debug/clk/lpuartN/clk_rate). The baud rate divider
      is derived from it.
```

## zephyr/dts/bindings/spi/epp,xen-lpspi.yaml
```yaml
# SPDX-License-Identifier: Apache-2.0

description: |
  NXP LPSPI controller passed through by Xen to a Zephyr DomU. Pin mux and
  clock are set up outside the DomU (System Manager, Dom0), so there are no
  pinctrl or clocks properties. Controller mode, 8-bit words, polled, chip
  select by GPIO (cs-gpios).

compatible: "epp,xen-lpspi"

include: [spi-controller.yaml, base.yaml]

properties:
  reg:
    required: true

  functional-clock-frequency:
    type: int
    default: 24000000
    description: |
      LPSPI functional clock in Hz, as set by the System Manager (Linux in
      Dom0: /sys/kernel/debug/clk/lpspiN/clk_rate). The SCK divider is
      derived from it.
```
