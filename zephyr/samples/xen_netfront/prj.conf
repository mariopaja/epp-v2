## CMakeLists.txt
```
# SPDX-License-Identifier: Apache-2.0

cmake_minimum_required(VERSION 3.20.0)
find_package(Zephyr REQUIRED HINTS $ENV{ZEPHYR_BASE})
project(xen_netfront)

target_sources(app PRIVATE src/main.c)
```

## prj.conf
```kconfig
CONFIG_EPP_XEN_XENSTORE=y
CONFIG_EPP_XEN_NETFRONT=y

CONFIG_NETWORKING=y
CONFIG_NET_IPV4=y
CONFIG_NET_IPV6=n
CONFIG_NET_UDP=y
CONFIG_NET_TCP=y
CONFIG_NET_DHCPV4=y
CONFIG_NET_MGMT=y
CONFIG_NET_MGMT_EVENT=y

CONFIG_LOG=y
CONFIG_NET_LOG=y
CONFIG_MAIN_STACK_SIZE=4096

# xenvm has no entropy source; DHCP only needs non-cryptographic random
# numbers (transaction ids, backoff). Not for TLS or other crypto.
CONFIG_TEST_RANDOM_GENERATOR=y
CONFIG_TIMER_RANDOM_GENERATOR=y
```

## src/main.c
```c
/*
 * SPDX-License-Identifier: Apache-2.0
 *
 * Step 2/3 of the Zephyr Xen network frontend: bring up the netfront
 * interface, get an IPv4 address by DHCP over the Dom0 bridge and print
 * the state every 5 s. Answer pings from the network.
 */

#include <stdio.h>
#include <zephyr/kernel.h>
#include <zephyr/net/net_if.h>
#include <zephyr/net/net_ip.h>
#include <zephyr/net/dhcpv4.h>
#include <zephyr/sys/printk.h>

int main(void)
{
	struct net_if *iface = net_if_get_default();
	char addr[NET_IPV4_ADDR_LEN];

	if (iface == NULL) {
		printk("xen_netfront: no network interface\n");
		return 0;
	}

	net_dhcpv4_start(iface);

	while (true) {
		struct net_linkaddr *ll = net_if_get_link_addr(iface);
		struct net_in_addr *ip = net_if_ipv4_get_global_addr(iface, NET_ADDR_PREFERRED);

		if (ip != NULL) {
			net_addr_ntop(NET_AF_INET, ip, addr, sizeof(addr));
		} else {
			snprintf(addr, sizeof(addr), "none");
		}

		printk("xen_netfront: carrier %s, mac %02x:%02x:%02x:%02x:%02x:%02x, ipv4 %s\n",
		       net_if_is_carrier_ok(iface) ? "on" : "off", ll->addr[0], ll->addr[1],
		       ll->addr[2], ll->addr[3], ll->addr[4], ll->addr[5], addr);
		k_msleep(5000);
	}

	return 0;
}
```
